## config/west.yml
```yaml
manifest:
  remotes:
    - name: zmkfirmware
      url-base: https://github.com/zmkfirmware
    - name: ReFil
      url-base: https://github.com/ReFil
    - name: tobiasarndt
      url-base: https://github.com/tobiasarndt
    - name: infused-kim
      url-base: https://github.com/infused-kim

  projects:
    - name: zmk
      remote: ReFil
      revision: split-data-xfer
      import: app/west.yml

    - name: tmp-npv
      remote: infused-kim
      revision: main

  self:
    path: config
```
